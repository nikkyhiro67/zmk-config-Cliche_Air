/* ================================================================
 * Cliche_Air Left Overlay
 * ---------------------------------------------------------------
 * - Left-hand key matrix
 * - Encoder enabled
 * - No trackball
 * ================================================================ */

#include "cliche_air.dtsi"

/* 左側の列設定 */
&kscan0 {
    col-gpios = <&xiao_d 10 GPIO_ACTIVE_HIGH>,
                <&xiao_d 9 GPIO_ACTIVE_HIGH>,
                <&xiao_d 8 GPIO_ACTIVE_HIGH>,
                <&xiao_d 7 GPIO_ACTIVE_HIGH>,
                <&gpio0 10 GPIO_ACTIVE_HIGH>,
                <&gpio0 9 GPIO_ACTIVE_HIGH>;
};

/* 左側エンコーダ有効化 */
&left_encoder {
    status = "okay";
};

## app/drivers/battery_voltage/Kconfig
```kconfig
config ZMK_BATTERY_VOLTAGE
    bool "Battery voltage measurement driver"
    default y
    help
      Enables ADC-based battery voltage measurement and provides a simple API.
```

## app/drivers/ext_power_transient/Kconfig
```kconfig
config ZMK_EXT_POWER_TRANSIENT
    bool "External power transient control driver"
    default y
```

## app/drivers/led_stripnize/Kconfig
```kconfig
config ZMK_LED_STRIPNIZE
    bool "LED stripnize (RGB LED strip driver)"
    default y
```

## app/drivers/pmw3610/Kconfig
```kconfig
# app/drivers/pmw3610/Kconfig

config ZMK_PMW3610
    bool "PMW3610 Optical Trackball Sensor Driver"
    default y
    depends on GPIO && (SPI || ARCH_POSIX) && ZMK_POINTING
    help
      Enable PixArt PMW3610 optical trackball/optical sensor driver.
      This driver supports SPI mode or SDIO (single-wire) mode using GPIO bit-banging.
```

## boards/shields/cliche_air/Kconfig.defconfig
```kconfig
if SHIELD_CLICHE_AIR_R

config ZMK_KEYBOARD_NAME
    string
    default "cliche_air_r"

config ZMK_SPLIT
    bool
    default y

config ZMK_SPLIT_ROLE_CENTRAL
    bool
    default y

config ZMK_SPLIT_ROLE_PERIPHERAL
    bool
    default n

endif

if SHIELD_CLICHE_AIR_L

config ZMK_KEYBOARD_NAME
    string
    default "cliche_air_l"

config ZMK_SPLIT
    bool
    default y

config ZMK_SPLIT_ROLE_CENTRAL
    bool
    default n

config ZMK_SPLIT_ROLE_PERIPHERAL
    bool
    default y

endif
```

## boards/shields/cliche_air/Kconfig.shield
```kconfig
# ================================================================
# Cliche_Air Shield Kconfig
# ---------------------------------------------------------------
# Defines shield presence flags for Left and Right halves
# ================================================================

menu "Cliche_Air Shields"

config SHIELD_CLICHE_AIR_R
    bool "Cliche_Air Right (Central)"
    default $(shields_list_contains,cliche_air_r)
    help
        Enables the right-hand (central) shield for Cliche_Air.

config SHIELD_CLICHE_AIR_L
    bool "Cliche_Air Left (Peripheral)"
    default $(shields_list_contains,cliche_air_l)
    help
        Enables the left-hand (peripheral) shield for Cliche_Air.

endmenu
```

## config/boards/shields/Cliche_Air/Kconfig.defconfig
```kconfig
if SHIELD_CLICHE_AIR_R

config ZMK_KEYBOARD_NAME
    default "Cliche_Air_R"

config ZMK_SPLIT
    default y

config ZMK_SPLIT_ROLE_CENTRAL
    default y

config PMW3610
    default y
config ZMK_POINTING
    default y

config ZMK_BATTERY_REPORTING
    default y
config ZMK_SPLIT_BLE_CENTRAL_BATTERY_LEVEL_PROXY
    default y
config ZMK_SPLIT_BLE_CENTRAL_BATTERY_LEVEL_FETCHING
    default y

config ZMK_SLEEP
    default y
config ZMK_PM_SOFT_OFF
    default y
config ZMK_DRIVER_EXT_POWER_TRANSIENT
    default y

config LED_STRIP
    default y
config SPI
    default y

config ZMK_SETTINGS_SAVE_DEBOUNCE
    default 10000

config ZMK_DEFAULT_LAYER
    default y
config ZMK_DEFAULT_LAYER_MIN_INDEX
    int "min layer index configurable as default layer"
    default 0
config ZMK_DEFAULT_LAYER_MAX_INDEX
    int "max layer index configurable as default layer"
    default 4

endif

if SHIELD_CLICHE_AIR_L

config ZMK_KEYBOARD_NAME
    default "Cliche_Air_L"

config ZMK_SPLIT
    default y

config ZMK_BATTERY_REPORTING
    default y

config ZMK_SLEEP
    default y
config ZMK_PM_SOFT_OFF
    default y
config ZMK_DRIVER_EXT_POWER_TRANSIENT
    default y

config LED_STRIP
    default y
config SPI
    default y

config ZMK_SETTINGS_SAVE_DEBOUNCE
    default 10000

config ZMK_DEFAULT_LAYER
    default y
config ZMK_DEFAULT_LAYER_MIN_INDEX
    int "min layer index configurable as default layer"
    default 0
config ZMK_DEFAULT_LAYER_MAX_INDEX
    int "max layer index configurable as default layer"
    default 4

endif
```

## config/boards/shields/Cliche_Air/Kconfig.shield
```kconfig
config SHIELD_CLICHE_AIR_R
    def_bool $(shields_list_contains,Cliche_Air_R)

config SHIELD_CLICHE_AIR_L
    def_bool $(shields_list_contains,Cliche_Air_L)
```

## config/boards/shields/cliche_air_l/Kconfig.defconfig
```kconfig
if SHIELD_CLICHE_AIR_L

config ZMK_KEYBOARD_NAME
    default "Cliche_Air_L"

config ZMK_SPLIT
    default y

# Left is CENTRAL (親機) as you specified
config ZMK_SPLIT_ROLE_CENTRAL
    default y

endif
```

## config/boards/shields/cliche_air_l/Kconfig.shield
```kconfig
config SHIELD_CLICHE_AIR_L
    bool "Cliche Air Left (cliche_air_l)"
    select ZMK_KEYBOARD

if SHIELD_CLICHE_AIR_L

config ZMK_KEYBOARD_NAME
    default "Cliche_Air_L"

config ZMK_SPLIT
    default y

config ZMK_SPLIT_ROLE_CENTRAL
    default y

endif
```

## config/boards/shields/cliche_air_r/Kconfig.defconfig
```kconfig
if SHIELD_CLICHE_AIR_R

config ZMK_KEYBOARD_NAME
    default "Cliche_Air_R"

config ZMK_SPLIT
    default y

config ZMK_SPLIT_ROLE_PERIPHERAL
    default y

endif
```

## config/boards/shields/cliche_air_r/Kconfig.shield
```kconfig
config SHIELD_CLICHE_AIR_R
    bool "Cliche Air Right (cliche_air_r)"
    select ZMK_KEYBOARD
```

## config/west.yml
```yaml
manifest:
  remotes:
    - name: zmkfirmware
      url-base: https://github.com/zmkfirmware
    - name: nikkyhiro67
      url-base: https://github.com/nikkyhiro67
    - name: sekigon-gonnoc
      url-base: https://github.com/sekigon-gonnoc
    - name: caksoylar
      url-base: https://github.com/caksoylar

  projects:
    - name: zmk
      remote: zmkfirmware
      revision: v0.2.1
      import: app/west.yml
    - name: zmk-pmw3610-driver
      remote: nikkyhiro67
      revision: main
      path: modules/pmw3610-driver
    - name: zmk-module-battery-monitor
      remote: nikkyhiro67
      revision: main
      path: modules/zmk-module-battery-monitor
    - name: zmk-module-led-indicator
      remote: nikkyhiro67
      revision: main
      path: modules/zmk-module-led-indicator
    - name: zmk-feature-non-lipo-battery-management
      remote: nikkyhiro67
      revision: main
    - name: zmk-rgbled-widget
      remote: caksoylar
      revision: main
  self:
    path: config
```
